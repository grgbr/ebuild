## Config.in
```kconfig
config TEST
	bool "un test"
	default n

config OTHER_TEST
	bool "un autre test"
	default y
```

## test/Config.in
```kconfig
################################################################################
# SPDX-License-Identifier: GPL-3.0-only
#
# This file is part of eBuild.
# Copyright (C) 2019-2023 Grégor Boirie <gregor.boirie@free.fr>
################################################################################

config TEST
	bool "un test"
	default n

config OTHER_TEST
	bool "un autre test"
	default y
```
